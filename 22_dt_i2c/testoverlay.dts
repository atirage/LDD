/dts-v1/;
/plugin/;
/ {
	compatible = "brcm, bcm2835";
	fragment@0 {
		target = <&i2c1>;
		__overlay__ {
			#address-cells = <1>;
			#size-cells = <0>;
			
			my_phat: my_phat@2c {
				compatible = "brightlight, myphat";
				reg = <0x2c>;
				status = "okay";
			};
		};
	};
};
